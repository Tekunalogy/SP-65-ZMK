## app/boards/shields/sp65/Kconfig.defconfig
```kconfig
if SHIELD_SP65

config ZMK_KEYBOARD_NAME
    default "SP-65-CZ"

config BT_DEVICE_NAME
	default ZMK_KEYBOARD_NAME

config USB_DEVICE_PRODUCT
	default ZMK_KEYBOARD_NAME

endif
```
